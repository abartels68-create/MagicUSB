## main/Kconfig.projbuild
```kconfig
menu "MagicUSB test options"

config MAGICUSB_FAULT_INJECTION
    bool "Enable NVS-controlled storage fault injection"
    default n
    help
        Bench-test only. Allows a provisioned one-shot fault_stage value to
        restart the device at selected update transitions. Leave disabled in
        normal and production firmware.

endmenu
```

## sdkconfig.defaults
```kconfig
CONFIG_IDF_TARGET="esp32s3"
CONFIG_ESPTOOLPY_FLASHSIZE_16MB=y
CONFIG_PARTITION_TABLE_CUSTOM=y
CONFIG_PARTITION_TABLE_CUSTOM_FILENAME="partitions.csv"
CONFIG_TINYUSB_MSC_ENABLED=y
CONFIG_TINYUSB_DESC_USE_ESPRESSIF_VID=y
CONFIG_TINYUSB_DESC_PRODUCT_STRING="MagicUSB Wireless Drive"
CONFIG_TINYUSB_DESC_MANUFACTURER_STRING="MagicUSB"
CONFIG_TINYUSB_DESC_SERIAL_STRING="development"
CONFIG_COMPILER_OPTIMIZATION_SIZE=y
CONFIG_LOG_DEFAULT_LEVEL_INFO=y
CONFIG_MBEDTLS_CERTIFICATE_BUNDLE=y
CONFIG_MBEDTLS_CERTIFICATE_BUNDLE_DEFAULT_FULL=y
```
